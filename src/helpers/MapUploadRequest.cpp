#include "MapUploadRequest.h"

#include <math.h>
#include <stdio.h>
#include <string.h>

namespace {

// Longest string formatNumber() can produce for any finite float ("%.3f" of a
// large magnitude, before trailing zeros are trimmed).
static const size_t kMaxNumberChars = 16;

// Bounded string appender. Every append is checked, and once anything has
// overflowed the whole build is failed rather than emitting a truncated prefix —
// a half-written data string would be signed and rejected, which is far harder
// to diagnose than a refused upload.
struct Appender {
  char* out;
  size_t cap;  // buffer size including the NUL
  size_t len;
  bool ok;

  Appender(char* buffer, size_t buffer_size)
      : out(buffer), cap(buffer_size), len(0), ok(buffer != nullptr && buffer_size > 0) {
    if (ok) out[0] = '\0';
  }

  void raw(const char* s, size_t n) {
    if (!ok) return;
    if (len + n + 1 > cap) { ok = false; return; }
    memcpy(out + len, s, n);
    len += n;
    out[len] = '\0';
  }

  void str(const char* s) { raw(s, strlen(s)); }

  void uint8(uint8_t v) {
    char tmp[4];
    const int n = snprintf(tmp, sizeof(tmp), "%u", static_cast<unsigned>(v));
    if (n < 0 || static_cast<size_t>(n) >= sizeof(tmp)) { ok = false; return; }
    raw(tmp, static_cast<size_t>(n));
  }

  void number(float v) {
    char tmp[kMaxNumberChars];
    const size_t n = MapUploadRequest::formatNumber(tmp, sizeof(tmp), v);
    if (n == 0) { ok = false; return; }
    raw(tmp, n);
  }

  void hex(const uint8_t* bytes, size_t n) {
    if (!ok) return;
    if (bytes == nullptr) { ok = false; return; }
    if (len + (n * 2) + 1 > cap) { ok = false; return; }
    const size_t written = MapUploadRequest::toHexLower(out + len, cap - len, bytes, n);
    if (written != n * 2) { ok = false; return; }
    len += written;
  }

  // Fail the build and empty the buffer. Callers return 0 straight after.
  int fail() {
    if (out != nullptr && cap > 0) out[0] = '\0';
    return 0;
  }
};

// Worst-case sizing for the two public buffers. These deliberately assert on the
// declared constants so that widening the frame limit or a field name without
// re-checking the buffers is a build error, not a runtime truncation.
static const size_t kDataFixedChars =
    18 +  // {"params":{"freq":
     6 +  // ,"cr":
     6 +  // ,"sf":
     6 +  // ,"bw":
    23 +  // },"links":["meshcore://
     3;   // "]}
static const size_t kDataWorstCase =
    kDataFixedChars + kMaxNumberChars + 3 + 3 + kMaxNumberChars +
    (MapUploadRequest::kMaxFrameBytes * 2) + 1;
static_assert(MapUploadRequest::kDataBufferSize >= kDataWorstCase,
              "kDataBufferSize cannot hold a maximum-length advert frame");

// The data string is generated by buildSignedData() and contains exactly 14
// double quotes and no backslashes or control characters, so escaping can only
// ever add those 14 bytes. The bound is stated against the buffer size rather
// than the exact count so it stays valid if a field is added.
static const size_t kMaxEscapeGrowth = 32;
static const size_t kBodyFixedChars =
     9 +  // {"data":"
    15 +  // ","signature":"
    15 +  // ","publicKey":"
     2;   // "}
static const size_t kBodyWorstCase =
    kBodyFixedChars + (MapUploadRequest::kDataBufferSize - 1) + kMaxEscapeGrowth +
    (SIGNATURE_SIZE * 2) + (PUB_KEY_SIZE * 2) + 1;
static_assert(MapUploadRequest::kBodyBufferSize >= kBodyWorstCase,
              "kBodyBufferSize cannot hold a maximum-length data string");

}  // namespace

size_t MapUploadRequest::formatNumber(char* out, size_t out_size, float value) {
  if (out == nullptr || out_size == 0) return 0;
  out[0] = '\0';
  if (!isfinite(value)) return 0;

  const int n = snprintf(out, out_size, "%.3f", static_cast<double>(value));
  if (n < 0 || static_cast<size_t>(n) >= out_size) { out[0] = '\0'; return 0; }

  // "%.3f" always emits a decimal point and never an exponent, so trimming the
  // fraction is enough to match JavaScript's shortest-round-trip rendering for
  // the values the radio prefs actually hold.
  size_t len = static_cast<size_t>(n);
  if (memchr(out, '.', len) != nullptr) {
    while (len > 0 && out[len - 1] == '0') len--;
    if (len > 0 && out[len - 1] == '.') len--;
  }
  out[len] = '\0';
  return len;
}

size_t MapUploadRequest::toHexLower(char* out, size_t out_size, const uint8_t* bytes, size_t len) {
  if (out == nullptr || out_size == 0) return 0;
  out[0] = '\0';
  if (bytes == nullptr && len > 0) return 0;
  if (out_size < (len * 2) + 1) return 0;

  static const char kDigits[] = "0123456789abcdef";
  for (size_t i = 0; i < len; i++) {
    out[i * 2]     = kDigits[(bytes[i] >> 4) & 0x0F];
    out[i * 2 + 1] = kDigits[bytes[i] & 0x0F];
  }
  out[len * 2] = '\0';
  return len * 2;
}

size_t MapUploadRequest::escapeJsonString(char* out, size_t out_size, const char* in) {
  if (out == nullptr || out_size == 0) return 0;
  out[0] = '\0';
  if (in == nullptr) return 0;

  size_t len = 0;
  for (const char* p = in; *p != '\0'; p++) {
    const unsigned char c = static_cast<unsigned char>(*p);
    char esc[7];
    size_t esc_len;
    switch (c) {
      case '"':  memcpy(esc, "\\\"", 2); esc_len = 2; break;
      case '\\': memcpy(esc, "\\\\", 2); esc_len = 2; break;
      case '\b': memcpy(esc, "\\b", 2);  esc_len = 2; break;
      case '\f': memcpy(esc, "\\f", 2);  esc_len = 2; break;
      case '\n': memcpy(esc, "\\n", 2);  esc_len = 2; break;
      case '\r': memcpy(esc, "\\r", 2);  esc_len = 2; break;
      case '\t': memcpy(esc, "\\t", 2);  esc_len = 2; break;
      default:
        if (c < 0x20) {
          const int n = snprintf(esc, sizeof(esc), "\\u%04x", c);
          if (n != 6) { out[0] = '\0'; return 0; }
          esc_len = 6;
        } else {
          esc[0] = static_cast<char>(c);
          esc_len = 1;
        }
        break;
    }
    if (len + esc_len + 1 > out_size) { out[0] = '\0'; return 0; }
    memcpy(out + len, esc, esc_len);
    len += esc_len;
  }
  out[len] = '\0';
  return len;
}

bool MapUploadRequest::paramsValid(const RadioParams& params) {
  // "Set", not "sane": the firmware already constrains these, and rejecting a
  // legitimate but unusual regional profile here would silently disable the
  // uploader. What this catches is the genuinely useless case — prefs that have
  // never been populated, which would otherwise place the node on a mesh that
  // does not exist.
  if (!isfinite(params.freq_mhz) || params.freq_mhz <= 0.0f) return false;
  if (!isfinite(params.bw_khz) || params.bw_khz <= 0.0f) return false;
  if (params.sf == 0 || params.cr == 0) return false;
  return true;
}

int MapUploadRequest::buildSignedData(char* out, size_t out_size, const RadioParams& params,
                                      const uint8_t* frame, size_t frame_len) {
  Appender a(out, out_size);
  if (!a.ok) return a.fail();
  if (frame == nullptr || frame_len == 0 || frame_len > kMaxFrameBytes) return a.fail();
  if (!paramsValid(params)) return a.fail();

  a.str("{\"params\":{\"freq\":");
  a.number(params.freq_mhz);
  a.str(",\"cr\":");
  a.uint8(params.cr);
  a.str(",\"sf\":");
  a.uint8(params.sf);
  a.str(",\"bw\":");
  a.number(params.bw_khz);
  a.str("},\"links\":[\"meshcore://");
  a.hex(frame, frame_len);
  a.str("\"]}");

  if (!a.ok) return a.fail();
  return static_cast<int>(a.len);
}

int MapUploadRequest::buildRequestBody(char* out, size_t out_size, const char* data_json,
                                       const uint8_t* signature, size_t signature_len,
                                       const uint8_t* public_key, size_t public_key_len) {
  Appender a(out, out_size);
  if (!a.ok) return a.fail();
  if (data_json == nullptr || data_json[0] == '\0') return a.fail();
  if (signature == nullptr || signature_len == 0) return a.fail();
  if (public_key == nullptr || public_key_len == 0) return a.fail();

  a.str("{\"data\":\"");
  // Escape straight into the tail of the output buffer, then advance past it —
  // avoids a second full-size copy of the data string on the stack.
  if (a.ok) {
    const size_t escaped = escapeJsonString(a.out + a.len, a.cap - a.len, data_json);
    if (escaped == 0) return a.fail();
    a.len += escaped;
  }
  a.str("\",\"signature\":\"");
  a.hex(signature, signature_len);
  a.str("\",\"publicKey\":\"");
  a.hex(public_key, public_key_len);
  a.str("\"}");

  if (!a.ok) return a.fail();
  return static_cast<int>(a.len);
}
